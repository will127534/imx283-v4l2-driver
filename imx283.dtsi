cam_node: imx283@1a {
	reg = <0x1a>;
	status = "okay";
	compatible = "sony,imx283";
	clocks = <&cam1_clk>;
	clock-names = "xclk";

	VANA-supply = <&cam1_reg>;	/* 2.8v */
	VDIG-supply = <&cam_dummy_reg>;	/* 1.2v */
	VDDL-supply = <&cam_dummy_reg>;	/* 1.8v */

	rotation = <0>;
	orientation = <0>;

	port {
		cam_endpoint: endpoint {
			clock-lanes = <0>;
			data-lanes = <1 2 3 4>;
			clock-noncontinuous;
			remote-endpoint = <&csi_ep>;
			link-frequencies =
				/bits/ 64 <450000000>;
		};
	};

};
